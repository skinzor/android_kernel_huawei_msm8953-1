## Kconfig
```kconfig
#
# For a description of the syntax of this configuration file,
# see Documentation/kbuild/kconfig-language.txt.
#
mainmenu "Linux/$ARCH $KERNELVERSION Kernel Configuration"

config SRCARCH
	string
	option env="SRCARCH"

config WIFI_WAKE_SRC
	bool "enable print wifi wakeup src in sleep mode"
	depends on HUAWEI_KERNEL
	default n
	help
	  Enable print wifi wakeup src in sleep mode.
source "arch/$SRCARCH/Kconfig"
```
