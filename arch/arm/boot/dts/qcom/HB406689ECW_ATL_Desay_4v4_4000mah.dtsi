
qcom,qrd-4v4-4000mAh-ATL-Desay-data {
	/* #huawei_bt029atl_4000mah_averaged_masterslave*/
	qcom,max-voltage-uv = <4400000>;
	qcom,nom-batt-capacity-mah = <4000>;
	qcom,batt-id-kohm = <64>;
	qcom,battery-beta = <3435>;
	qcom,battery-type = "HB406689ECW_ATL_Desay";
	qcom,fg-cc-cv-threshold-mv = <4380>;
	qcom,chg-rslow-comp-c1 = <2588796>;
	qcom,chg-rslow-comp-c2 = <4002758>;
	qcom,chg-rs-to-rslow = <850663>;
	qcom,chg-rslow-comp-thr = <0xAE>;
	qcom,checksum = <0x5512>;
	qcom,gui-version = "PMI8950GUI - 2.0.0.16";
	qcom,fg-profile-data = [
		 EA 83 34 7D 
		 75 81 0E 7C 
		 58 83 05 64 
		 F4 81 A2 8C 
		 06 82 3F 99 
		 C9 B6 C9 C1 
		 5C 11 08 88 
		 12 7E 03 82 
		 8A 7C 56 83 
		 89 63 06 80 
		 32 8C 2D 82 
		 4D 9A A2 BD 
		 FB CA 5B 0E 
		 76 0F 9E 59 
		 14 70 29 FC 
		 1F 2E B7 44 
		 07 39 00 00 
		 13 45 F2 30 
		 1E 2A 00 00 
		 00 00 00 00 
		 00 00 00 00 
		 A9 70 14 70 
		 90 70 97 8A 
		 30 76 B7 6A 
		 F7 6F 43 79 
		 8F 74 04 68 
		 0A 5C F4 B9 
		 11 CB 62 01 
		 67 A0 71 0C 
		 28 00 FF 36 
		 F0 11 30 03 
		 00 00 00 0C 
	];
};
