/{
		huawei_fac_info {
		compatible = "huawei,hw_fac_info";
		fac,product_name = "KOB-L09";
		fac,hardware_ver = "SH1KOBL09AM";
		fac,software_ver = "KOB_L09_VA";
		fac,simcard_adapt = "support";
		status = "ok";
	};
};
